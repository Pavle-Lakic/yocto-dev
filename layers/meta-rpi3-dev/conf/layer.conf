## layers/meta-rpi3-dev/conf/layer.conf
```bitbake
# We have a conf and classes directory, add to BBPATH
BBPATH .= ":${LAYERDIR}"

# We have recipes-* directories, add to BBFILES
BBFILES += "${LAYERDIR}/recipes-*/*/*.bb \
            ${LAYERDIR}/recipes-*/*/*.bbappend"

BBFILE_COLLECTIONS += "meta-rpi3-dev"
BBFILE_PATTERN_meta-rpi3-dev = "^${LAYERDIR}/"
BBFILE_PRIORITY_meta-rpi3-dev = "6"

LAYERDEPENDS_meta-rpi3-dev = "core"
LAYERSERIES_COMPAT_meta-rpi3-dev = "kirkstone"

MACHINE = "raspberrypi3-64"
ENABLE_UART = "1"

GIT = "/usr/bin/git"

IMAGE_INSTALL:append = " python3"
```
